includes
{
  // Import required CAPL include files
  //--- begin generated part --- Block start #GlobalBody_Includes#; do not delete this line and do not add application code in this code block!
  /* #ChannelGlobalStart# |CAN2| #BusGlobalStart# |NwSample| */
  /* #ChannelGlobalEnd# |CAN2| #BusGlobalEnd# |NwSample| */
  //--- end generated part --- Block end #GlobalBody_Includes#; do not delete this line! Add application code below this line.
  //--- begin generated part --- Block start #Body_Includes#; do not delete this line and do not add application code in this code block!
  /* #ChannelStart# |CAN2| #BusStart# |NwSample| */
  #include "..\CAPL\Vector-IL-KL30-Helper_CAN2.cin"
  #include "..\CAPL\Vector-NM-Panel-Helper_CAN2.cin"
  #include "..\CAPL\Vector-NM-ASR-Helper_CAN2.cin"
  /* #ChannelEnd# |CAN2| #BusEnd# |NwSample| */
  //--- end generated part --- Block end #Body_Includes#; do not delete this line! Add application code below this line.
}

variables
{
  // Define global variables for this CAPL file

  /*--- #GenHeader Begin# --- begin generated comment ---
  | Generated on Wednesday, May 22, 2024, 13:58:33
  | By ModelGenerator for Vector 1.6.4.13, ModelGeneratorVectorDLL 1.6.4.85
  | Package Vector 4.0.69
  | Target Bus: NwSample; Channel: CAN2; DB Cluster: NwSample;
  | From Database: NwSample.dbc
  | CANoe Version 18.0.185.0
    --- #GenHeader End  # --- end generated comment --- */

  char gECU[256] = "SGW";
  //--- begin generated part --- Block start #Hdr_GlobalVariables#; do not delete this line and do not add application code in this code block!
  /* #ChannelStart# |CAN2| #BusStart# |NwSample| */
  /* #ChannelEnd# |CAN2| #BusEnd# |NwSample| */
  //--- end generated part --- Block end #Hdr_GlobalVariables#; do not delete this line! Add application code below this line.
  //--- begin generated part --- Block start #GlobalBody_GlobalVariables#; do not delete this line and do not add application code in this code block!
  /* #ChannelGlobalStart# |CAN2| #BusGlobalStart# |NwSample| */
  /* #ChannelGlobalEnd# |CAN2| #BusGlobalEnd# |NwSample| */
  //--- end generated part --- Block end #GlobalBody_GlobalVariables#; do not delete this line! Add application code below this line.
  //--- begin generated part --- Block start #Body_GlobalVariables#; do not delete this line and do not add application code in this code block!
  /* #ChannelStart# |CAN2| #BusStart# |NwSample| */
  char gCAN2BusName[256] = "NwSample";
  int gCAN2Channel = 2; // The channel the bus is attached to

  long gCAN2DisturbanceMode;
  long gCAN2DisturbanceCount;
  long gCAN2DisturbanceValue;
  long gCAN2DisturbanceContinueMode;
  double gCAN2DisturbancePeriod;
  /* #ChannelEnd# |CAN2| #BusEnd# |NwSample| */
  //--- end generated part --- Block end #Body_GlobalVariables#; do not delete this line! Add application code below this line.
}

on preStart
{
  // Initialize CAPL includes and node's modules/DLLs
  //--- begin generated part --- Block start #Hdr_OnInit#; do not delete this line and do not add application code in this code block!
  /* #ChannelStart# |CAN2| #BusStart# |NwSample| */
  /* #ChannelEnd# |CAN2| #BusEnd# |NwSample| */
  //--- end generated part --- Block end #Hdr_OnInit#; do not delete this line! Add application code below this line.
  //--- begin generated part --- Block start #GlobalBody_OnInit#; do not delete this line and do not add application code in this code block!
  /* #ChannelGlobalStart# |CAN2| #BusGlobalStart# |NwSample| */
  /* #ChannelGlobalEnd# |CAN2| #BusGlobalEnd# |NwSample| */
  //--- end generated part --- Block end #GlobalBody_OnInit#; do not delete this line! Add application code below this line.
  //--- begin generated part --- Block start #Body_OnInit#; do not delete this line and do not add application code in this code block!
  /* #ChannelStart# |CAN2| #BusStart# |NwSample| */
  ILCAN2_OnInit();
  NMCAN2_OnInit();
  /* #ChannelEnd# |CAN2| #BusEnd# |NwSample| */
  //--- end generated part --- Block end #Body_OnInit#; do not delete this line! Add application code below this line.
}

on start
{
  // Start CAPL includes and node's modules/DLLs
  //--- begin generated part --- Block start #Hdr_OnStart#; do not delete this line and do not add application code in this code block!
  /* #ChannelStart# |CAN2| #BusStart# |NwSample| */
  /* #ChannelEnd# |CAN2| #BusEnd# |NwSample| */
  //--- end generated part --- Block end #Hdr_OnStart#; do not delete this line! Add application code below this line.
  //--- begin generated part --- Block start #GlobalBody_OnStart#; do not delete this line and do not add application code in this code block!
  /* #ChannelGlobalStart# |CAN2| #BusGlobalStart# |NwSample| */
  /* #ChannelGlobalEnd# |CAN2| #BusGlobalEnd# |NwSample| */
  //--- end generated part --- Block end #GlobalBody_OnStart#; do not delete this line! Add application code below this line.
  //--- begin generated part --- Block start #Body_OnStart#; do not delete this line and do not add application code in this code block!
  /* #ChannelStart# |CAN2| #BusStart# |NwSample| */
  ILCAN2_OnStart();
  NMCAN2_OnStart();
  /* #ChannelEnd# |CAN2| #BusEnd# |NwSample| */
  //--- end generated part --- Block end #Body_OnStart#; do not delete this line! Add application code below this line.
}

on preStop
{
  // Prepare stopping
  //--- begin generated part --- Block start #Hdr_OnStopping#; do not delete this line and do not add application code in this code block!
  /* #ChannelStart# |CAN2| #BusStart# |NwSample| */
  /* #ChannelEnd# |CAN2| #BusEnd# |NwSample| */
  //--- end generated part --- Block end #Hdr_OnStopping#; do not delete this line! Add application code below this line.
  //--- begin generated part --- Block start #GlobalBody_OnStopping#; do not delete this line and do not add application code in this code block!
  /* #ChannelGlobalStart# |CAN2| #BusGlobalStart# |NwSample| */
  /* #ChannelGlobalEnd# |CAN2| #BusGlobalEnd# |NwSample| */
  //--- end generated part --- Block end #GlobalBody_OnStopping#; do not delete this line! Add application code below this line.
  //--- begin generated part --- Block start #Body_OnStopping#; do not delete this line and do not add application code in this code block!
  /* #ChannelStart# |CAN2| #BusStart# |NwSample| */
  /* #ChannelEnd# |CAN2| #BusEnd# |NwSample| */
  //--- end generated part --- Block end #Body_OnStopping#; do not delete this line! Add application code below this line.
}

on stopMeasurement
{
  // Stop actions
  //--- begin generated part --- Block start #Hdr_OnStop#; do not delete this line and do not add application code in this code block!
  /* #ChannelStart# |CAN2| #BusStart# |NwSample| */
  /* #ChannelEnd# |CAN2| #BusEnd# |NwSample| */
  //--- end generated part --- Block end #Hdr_OnStop#; do not delete this line! Add application code below this line.
  //--- begin generated part --- Block start #GlobalBody_OnStop#; do not delete this line and do not add application code in this code block!
  /* #ChannelGlobalStart# |CAN2| #BusGlobalStart# |NwSample| */
  /* #ChannelGlobalEnd# |CAN2| #BusGlobalEnd# |NwSample| */
  //--- end generated part --- Block end #GlobalBody_OnStop#; do not delete this line! Add application code below this line.
  //--- begin generated part --- Block start #Body_OnStop#; do not delete this line and do not add application code in this code block!
  /* #ChannelStart# |CAN2| #BusStart# |NwSample| */
  /* #ChannelEnd# |CAN2| #BusEnd# |NwSample| */
  //--- end generated part --- Block end #Body_OnStop#; do not delete this line! Add application code below this line.
}

void StartSim(dword busContext, int busActive, int mode)
{
  // Called when ... due to ...
  //   mode == 1: ILControlResume
  //   mode == 2: ILControlStart
  //   mode == 3: ILControlSimulationOn
  //--- begin generated part --- Block start #Hdr_StartSim#; do not delete this line and do not add application code in this code block!
  /* #ChannelStart# |CAN2| #BusStart# |NwSample| */
  /* #ChannelEnd# |CAN2| #BusEnd# |NwSample| */
  //--- end generated part --- Block end #Hdr_StartSim#; do not delete this line! Add application code below this line.
  //write("[%.6f %NODE_NAME%] StartSim(0x%X, %d, %d)", TimeNowNS()/1e9, busContext, busActive, mode);
  //--- begin generated part --- Block start #Body_StartSim#; do not delete this line and do not add application code in this code block!
  /* #ChannelStart# |CAN2| #BusStart# |NwSample| */
  /* #ChannelEnd# |CAN2| #BusEnd# |NwSample| */
  //--- end generated part --- Block end #Body_StartSim#; do not delete this line! Add application code below this line.
}

void StopSim(dword busContext, int busActive, int mode)
{
  // Called when ... due to ...
  //   mode == 1: ILControlWait
  //   mode == 2: ILControlStop
  //   mode == 3: ILControlSimulationOff
  //--- begin generated part --- Block start #Hdr_StopSim#; do not delete this line and do not add application code in this code block!
  /* #ChannelStart# |CAN2| #BusStart# |NwSample| */
  /* #ChannelEnd# |CAN2| #BusEnd# |NwSample| */
  //--- end generated part --- Block end #Hdr_StopSim#; do not delete this line! Add application code below this line.
  //write("[%.6f %NODE_NAME%] StopSim(0x%X, %d, %d)", TimeNowNS()/1e9, busContext, busActive, mode);
  //--- begin generated part --- Block start #Body_StopSim#; do not delete this line and do not add application code in this code block!
  /* #ChannelStart# |CAN2| #BusStart# |NwSample| */
  /* #ChannelEnd# |CAN2| #BusEnd# |NwSample| */
  //--- end generated part --- Block end #Body_StopSim#; do not delete this line! Add application code below this line.
}

on sysvar_update sysvar::IL::Klemme15
{
  // Handle system state variable
  //--- begin generated part --- Block start #Hdr_KL15_Klemme15#; do not delete this line and do not add application code in this code block!
  /* #ChannelStart# |CAN2| #BusStart# |NwSample| */
  /* #ChannelEnd# |CAN2| #BusEnd# |NwSample| */
  //--- end generated part --- Block end #Hdr_KL15_Klemme15#; do not delete this line! Add application code below this line.
  //--- begin generated part --- Block start #Body_KL15_Klemme15#; do not delete this line and do not add application code in this code block!
  /* #ChannelStart# |CAN2| #BusStart# |NwSample| */
  ILCAN2_OnEnvKlemme15(@this);
  /* #ChannelEnd# |CAN2| #BusEnd# |NwSample| */
  //--- end generated part --- Block end #Body_KL15_Klemme15#; do not delete this line! Add application code below this line.
}

on sysvar_update sysvar::IL::Klemme30
{
  // Handle system state variable
  //--- begin generated part --- Block start #Hdr_KL30_Klemme30#; do not delete this line and do not add application code in this code block!
  /* #ChannelStart# |CAN2| #BusStart# |NwSample| */
  /* #ChannelEnd# |CAN2| #BusEnd# |NwSample| */
  //--- end generated part --- Block end #Hdr_KL30_Klemme30#; do not delete this line! Add application code below this line.
  //--- begin generated part --- Block start #Body_KL30_Klemme30#; do not delete this line and do not add application code in this code block!
  /* #ChannelStart# |CAN2| #BusStart# |NwSample| */
  ILCAN2_OnEnvKlemme30(@this);
  /* #ChannelEnd# |CAN2| #BusEnd# |NwSample| */
  //--- end generated part --- Block end #Body_KL30_Klemme30#; do not delete this line! Add application code below this line.
}

dword applILTxPending(long aId, dword aDlc, byte data[])
{
  dword ret = 1;
  //--- begin generated part --- Block start #Hdr_applILTxPending#; do not delete this line and do not add application code in this code block!
  /* #ChannelStart# |CAN2| #BusStart# |NwSample| */
  /* #ChannelEnd# |CAN2| #BusEnd# |NwSample| */
  //--- end generated part --- Block end #Hdr_applILTxPending#; do not delete this line! Add application code below this line.
  //--- begin generated part --- Block start #Body_applILTxPending#; do not delete this line and do not add application code in this code block!
  /* #ChannelStart# |CAN2| #BusStart# |NwSample| */
  /* #ChannelEnd# |CAN2| #BusEnd# |NwSample| */
  //--- end generated part --- Block end #Body_applILTxPending#; do not delete this line! Add application code below this line.
  return ret;
}

void Nm_NetworkStartInd()
{
  // Callback of CAN AUTOSAR NM DLL
  dword lBusContext;
  //--- begin generated part --- Block start #Hdr_Nm_NetworkStartInd#; do not delete this line and do not add application code in this code block!
  /* #ChannelStart# |CAN2| #BusStart# |NwSample| */
  /* #ChannelEnd# |CAN2| #BusEnd# |NwSample| */
  //--- end generated part --- Block end #Hdr_Nm_NetworkStartInd#; do not delete this line! Add application code below this line.
  lBusContext = GetBusContext();
  //--- begin generated part --- Block start #Body_Nm_NetworkStartInd#; do not delete this line and do not add application code in this code block!
  /* #ChannelStart# |CAN2| #BusStart# |NwSample| */
  if (lBusContext == gNMCAN2_BusContext) NMCAN2_IndNetworkStart();
  /* #ChannelEnd# |CAN2| #BusEnd# |NwSample| */
  //--- end generated part --- Block end #Body_Nm_NetworkStartInd#; do not delete this line! Add application code below this line.
  SetBusContext(lBusContext);
}

void Nm_NetworkModeInd()
{
  // Callback of CAN AUTOSAR NM DLL
  dword lBusContext;
  //--- begin generated part --- Block start #Hdr_Nm_NetworkModeInd#; do not delete this line and do not add application code in this code block!
  /* #ChannelStart# |CAN2| #BusStart# |NwSample| */
  /* #ChannelEnd# |CAN2| #BusEnd# |NwSample| */
  //--- end generated part --- Block end #Hdr_Nm_NetworkModeInd#; do not delete this line! Add application code below this line.
  lBusContext = GetBusContext();
  //--- begin generated part --- Block start #Body_Nm_NetworkModeInd#; do not delete this line and do not add application code in this code block!
  /* #ChannelStart# |CAN2| #BusStart# |NwSample| */
  if (lBusContext == gNMCAN2_BusContext) NMCAN2_IndNetworkMode();
  /* #ChannelEnd# |CAN2| #BusEnd# |NwSample| */
  //--- end generated part --- Block end #Body_Nm_NetworkModeInd#; do not delete this line! Add application code below this line.
  SetBusContext(lBusContext);
}

void Nm_NetworkTimeoutInd()
{
  // Callback of CAN AUTOSAR NM DLL
  dword lBusContext;
  //--- begin generated part --- Block start #Hdr_Nm_NetworkTimeoutInd#; do not delete this line and do not add application code in this code block!
  /* #ChannelStart# |CAN2| #BusStart# |NwSample| */
  /* #ChannelEnd# |CAN2| #BusEnd# |NwSample| */
  //--- end generated part --- Block end #Hdr_Nm_NetworkTimeoutInd#; do not delete this line! Add application code below this line.
  lBusContext = GetBusContext();
  //--- begin generated part --- Block start #Body_Nm_NetworkTimeoutInd#; do not delete this line and do not add application code in this code block!
  /* #ChannelStart# |CAN2| #BusStart# |NwSample| */
  if (lBusContext == gNMCAN2_BusContext) NMCAN2_IndNetworkTimeout();
  /* #ChannelEnd# |CAN2| #BusEnd# |NwSample| */
  //--- end generated part --- Block end #Body_Nm_NetworkTimeoutInd#; do not delete this line! Add application code below this line.
  SetBusContext(lBusContext);
}

void Nm_PrepareBusSleepModeInd()
{
  // Callback of CAN AUTOSAR NM DLL
  dword lBusContext;
  //--- begin generated part --- Block start #Hdr_Nm_PrepareBusSleepModeInd#; do not delete this line and do not add application code in this code block!
  /* #ChannelStart# |CAN2| #BusStart# |NwSample| */
  /* #ChannelEnd# |CAN2| #BusEnd# |NwSample| */
  //--- end generated part --- Block end #Hdr_Nm_PrepareBusSleepModeInd#; do not delete this line! Add application code below this line.
  lBusContext = GetBusContext();
  //--- begin generated part --- Block start #Body_Nm_PrepareBusSleepModeInd#; do not delete this line and do not add application code in this code block!
  /* #ChannelStart# |CAN2| #BusStart# |NwSample| */
  if (lBusContext == gNMCAN2_BusContext) NMCAN2_IndPrepareBusSleepMode();
  /* #ChannelEnd# |CAN2| #BusEnd# |NwSample| */
  //--- end generated part --- Block end #Body_Nm_PrepareBusSleepModeInd#; do not delete this line! Add application code below this line.
  SetBusContext(lBusContext);
}

void Nm_BusSleepModeInd()
{
  // Callback of CAN AUTOSAR NM DLL
  dword lBusContext;
  //--- begin generated part --- Block start #Hdr_Nm_BusSleepModeInd#; do not delete this line and do not add application code in this code block!
  /* #ChannelStart# |CAN2| #BusStart# |NwSample| */
  /* #ChannelEnd# |CAN2| #BusEnd# |NwSample| */
  //--- end generated part --- Block end #Hdr_Nm_BusSleepModeInd#; do not delete this line! Add application code below this line.
  lBusContext = GetBusContext();
  //--- begin generated part --- Block start #Body_Nm_BusSleepModeInd#; do not delete this line and do not add application code in this code block!
  /* #ChannelStart# |CAN2| #BusStart# |NwSample| */
  if (lBusContext == gNMCAN2_BusContext) NMCAN2_IndBusSleepMode();
  /* #ChannelEnd# |CAN2| #BusEnd# |NwSample| */
  //--- end generated part --- Block end #Body_Nm_BusSleepModeInd#; do not delete this line! Add application code below this line.
  SetBusContext(lBusContext);
}

void Nm_StateChangeNotification(long previousState, long currentState)
{
  // Callback of CAN AUTOSAR NM DLL
  dword lBusContext;
  //--- begin generated part --- Block start #Hdr_Nm_StateChangeNotification#; do not delete this line and do not add application code in this code block!
  /* #ChannelStart# |CAN2| #BusStart# |NwSample| */
  /* #ChannelEnd# |CAN2| #BusEnd# |NwSample| */
  //--- end generated part --- Block end #Hdr_Nm_StateChangeNotification#; do not delete this line! Add application code below this line.
  lBusContext = GetBusContext();
  //--- begin generated part --- Block start #Body_Nm_StateChangeNotification#; do not delete this line and do not add application code in this code block!
  /* #ChannelStart# |CAN2| #BusStart# |NwSample| */
  if (lBusContext == gNMCAN2_BusContext) NMCAN2_IndStateChangeNotification(previousState, currentState);
  /* #ChannelEnd# |CAN2| #BusEnd# |NwSample| */
  //--- end generated part --- Block end #Body_Nm_StateChangeNotification#; do not delete this line! Add application code below this line.
  SetBusContext(lBusContext);
}

//--- begin generated part --- Block start <#Helper_Functions#> do not delete this line and do not add application code in this code block!
/* #ChannelStart# |CAN2| #BusStart# |NwSample| */
/* #ChannelEnd# |CAN2| #BusEnd# |NwSample| */
//--- end generated part --- Block end <#Helper_Functions#> do not delete this line! Add application code below this line.

//--- begin generated part --- Block start <#SysVar_Handler#> do not delete this line and do not add application code in this code block!
/* #ChannelStart# |CAN2| #BusStart# |NwSample| */
on sysvar_update sysvar::IL_CAN2::NODES::N_SGW::EnableNode
{
  ILCAN2_Enable(@this && @sysvar::IL_CAN2::enable_AllNodes && @sysvar::IL::Klemme30);
}

on sysvar_update sysvar::IL_CAN2::enable_AllNodes
{
  ILCAN2_Enable(@this && @sysvar::IL_CAN2::NODES::N_SGW::EnableNode && @sysvar::IL::Klemme30);
}

on sysvar_update sysvar::NM_CAN2::NODES::N_SGW::DeactivateNM
{
  if( @this == 1 || @sysvar::NM_CAN2::StateControl::DeactivateNM == 1)
  {
    NMCAN2_Enable(0);
  }
  else
  {
    NMCAN2_Enable(1);
  }
}

on sysvar_update sysvar::NM_CAN2::StateControl::DeactivateNM
{
  if( @this == 1 || @sysvar::NM_CAN2::NODES::N_SGW::DeactivateNM == 1)
  {
    NMCAN2_Enable(0);
  }
  else
  {
    NMCAN2_Enable(1);
  }
}

on sysvar_update sysvar::IL_CAN2::NODES::N_SGW::MESSAGES::BCM_DoorControl::TIMINGS::EnableCyclic
{
  if (@this == 1)
  {
    SetBusContext(gILCAN2_BusContext);
    ILFaultInjectionEnableMsg  (NwSample::SGW::BCM_DoorControl);
  }
  else
  {
    SetBusContext(gILCAN2_BusContext);
    ILFaultInjectionDisableMsg (NwSample::SGW::BCM_DoorControl);
  }
}

on sysvar_update sysvar::IL_CAN2::NODES::N_SGW::MESSAGES::BCM_DoorControl::TIMINGS::SetNormalCycle
{
  if (@this == 1 && @sysvar::IL_CAN2::NODES::N_SGW::MESSAGES::BCM_DoorControl::TIMINGS::EnableCyclic)
  {
    @sysvar::IL_CAN2::NODES::N_SGW::MESSAGES::BCM_DoorControl::TIMINGS::SelectedPeriod = 0;
  }
}

on sysvar_update sysvar::IL_CAN2::NODES::N_SGW::MESSAGES::BCM_DoorControl::TIMINGS::SetNewCycleContinously
{
  if (@this == 1 && @sysvar::IL_CAN2::NODES::N_SGW::MESSAGES::BCM_DoorControl::TIMINGS::EnableCyclic)
  {
    @sysvar::IL_CAN2::NODES::N_SGW::MESSAGES::BCM_DoorControl::TIMINGS::SelectedPeriod = -1;
  }
}

on sysvar_update sysvar::IL_CAN2::NODES::N_SGW::MESSAGES::BCM_DoorControl::TIMINGS::SelectedPeriod
{
  if (@this == 0 && @sysvar::IL_CAN2::NODES::N_SGW::MESSAGES::BCM_DoorControl::TIMINGS::EnableCyclic)
  {
    SetBusContext(gILCAN2_BusContext);
    gCAN2DisturbancePeriod = @sysvar::IL_CAN2::NODES::N_SGW::MESSAGES::BCM_DoorControl::TIMINGS::NormalCyclePeriod;
    ILFaultInjectionResetMsgCycleTime(NwSample::SGW::BCM_DoorControl);
  }
  else if (@this == 1 && @sysvar::IL_CAN2::NODES::N_SGW::MESSAGES::BCM_DoorControl::TIMINGS::EnableCyclic)
  {
    SetBusContext(gILCAN2_BusContext);
    gCAN2DisturbancePeriod = @sysvar::IL_CAN2::NODES::N_SGW::MESSAGES::BCM_DoorControl::TIMINGS::ActiveCyclePeriod;
    ILFaultInjectionSetMsgCycleTime(NwSample::SGW::BCM_DoorControl, gCAN2DisturbancePeriod);
  }
  else if (@this == -1 && @sysvar::IL_CAN2::NODES::N_SGW::MESSAGES::BCM_DoorControl::TIMINGS::EnableCyclic)
  {
    SetBusContext(gILCAN2_BusContext);
    gCAN2DisturbancePeriod = @sysvar::IL_CAN2::NODES::N_SGW::MESSAGES::BCM_DoorControl::TIMINGS::CyclePeriod;
    ILFaultInjectionSetMsgCycleTime(NwSample::SGW::BCM_DoorControl, gCAN2DisturbancePeriod);
  }
}

on sysvar_update sysvar::IL_CAN2::NODES::N_SGW::MESSAGES::BCM_DoorControl::TIMINGS::SendOnce
{
  if (@this == 1)
  {
    SetBusContext(gILCAN2_BusContext);
    ILSetMsgEvent(NwSample::SGW::BCM_DoorControl);
  }
}

on sysvar_update sysvar::NM_CAN2::NODES::N_SGW::OpenNodePanel
{
  OpenNodePanel("NwSample::SGW", 1);
}

on sysvar_update sysvar::NM_CAN2::StateControl::CloseNodePanels
{
  OpenNodePanel("NwSample::SGW", 0);
}

/* #ChannelEnd# |CAN2| #BusEnd# |NwSample| */
//--- end generated part --- Block end <#SysVar_Handler#> do not delete this line! Add application code below this line.

//--- begin generated part --- Block start <#MsgUpdateFcns#> do not delete this line and do not add application code in this code block!
/* #ChannelStart# |CAN2| #BusStart# |NwSample| */
/* #ChannelEnd# |CAN2| #BusEnd# |NwSample| */
//--- end generated part --- Block end <#MsgUpdateFcns#> do not delete this line! Add application code below this line.

