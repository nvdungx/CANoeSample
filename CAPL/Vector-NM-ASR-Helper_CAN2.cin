variables
{
  /* NM-IL Include for CAN Vector IL with AUTOSAR NM
   *
   * This include file establishes the coupling between NM --> IL.
   *
   * The simulation node needs to load the components CANoeILNLVector.dll and AsrNM33.dll.
   *
   * Call NMCAN2_OnInit() in "on preStart()" of the main program!
   * Call NMCAN2_OnStart() in "on start()" of the main program!
   *
   * Version 6.5, (c) 2016 Vector Informatik GmbH, Department for Networks and Distributed Systems
   */

  const dword cNMCAN2_NMIndDebug      = 0x0001;
  const dword cNMCAN2_NMInitDebug     = 0x0002;
  const dword cNMCAN2_ILControlDebug  = 0x0010;
  
  const double cNMCAN2_NS2S = 1000000000.0;

  // Internally used variables and timers:
  dword   gNMCAN2_BusContext = 0;
  long    gNMCAN2_CurrentNMState = cCAN2_ASR_NM_STATE_UNDEFINED;
  long    gNMCAN2_CurrentNMInternalRequest = 0;
  
}

/*****************************************************************************
 * Include Initialization
 *****************************************************************************/

void NMCAN2_OnInit ()
{
  // This function must be called from the main program in "on preStart()"!

  //Nm_SetVerbosity(3);
  
  
  gNMCAN2_BusContext = GetBusNameContext(gCAN2BusName);

  if (strncmp("%NODE_NAME%", "_Gateway", 50) == 0)
  {
    gNMPCAN2_DebugFlags |= cNMCAN2_NMIndDebug;
    gNMPCAN2_DebugFlags |= cNMCAN2_NMInitDebug;
    gNMPCAN2_DebugFlags |= cNMPCAN2_NMControlDebug;
    gNMPCAN2_DebugFlags |= cNMCAN2_ILControlDebug;
  }

  SetBusContext(gNMCAN2_BusContext);
  Nm_ConfigureILNotifications( 0, 1 ); // regardless of NM callbacks inform IL
}

void NMCAN2_OnStart ()
{
  // This function must be called from the main program in "on start()"!
  
  if (gNMPCAN2_DebugFlags & cNMCAN2_NMInitDebug)
  {
    write("+++++++++ %NODE_NAME%: CAN NM on start()");
  }
}

/*****************************************************************************
 * NM Control
 * These functions can be called from the main program or react on
 * panel controls in order to manipulate the NM status of the controlled node.
 *****************************************************************************/

void NMCAN2_Enable (int enable)
{
  /* void NMCAN2_Enable (int enable);
   *
   *  Function enables/disables the Network Management DLL.
   */
  int wasEnabled = -1;

  //if (enable == wasEnabled) return;

  if (gNMPCAN2_DebugFlags & cNMPCAN2_NMControlDebug)
  {
    write("[%.6f %NODE_NAME%] NMCAN2_Enable(%d) called ...", TimeNowNS()/cNMCAN2_NS2S, enable);
  }

  SetBusContext(gNMCAN2_BusContext);
  if (enable == 1)
  {
    Nm_CtrlSimulationOn();
  }
  else
  {
    Nm_CtrlSimulationOff();
  }

  wasEnabled = enable;
}

void NMCAN2_SetApplActivity (int activity)
{
  /* void NMCAN2_SetApplActivity (int activity);
   *
   *  Function sets the application activity at the Interaction Layer.
   */
  int wasActivity = -1;

  //if (activity == wasActivity) return;

  if (gNMPCAN2_DebugFlags & cNMPCAN2_NMControlDebug)
  {
    write("[%.6f %NODE_NAME%] NMCAN2_SetApplActivity(%d) called ...", TimeNowNS()/cNMCAN2_NS2S, activity);
  }

  SetBusContext(gNMCAN2_BusContext);
  if (activity > 0)
  {
    Nm_SetApplicationActivity(1);
  }
  else
  {
    Nm_SetApplicationActivity(0);
  }

  wasActivity = activity;
}

NMCAN2_ReleaseBus()
{
  if (gNMPCAN2_DebugFlags & cNMPCAN2_NMControlDebug)
  {
    write("[%.6f %NODE_NAME%]: Nm_NetworkRelease()", TimeNowNS()/cNMCAN2_NS2S);
  }
  SetBusContext(gNMCAN2_BusContext);
  Nm_NetworkRelease();
}

NMCAN2_RequestBus ()
{
  if (gNMPCAN2_DebugFlags & cNMPCAN2_NMControlDebug)
  {
    write("[%.6f %NODE_NAME%]: Nm_NetworkRequest()", TimeNowNS()/cNMCAN2_NS2S);
  }
  SetBusContext(gNMCAN2_BusContext);
  Nm_NetworkRequest();
}

NMCAN2_PassiveBusStart ()
{
  if (gNMPCAN2_DebugFlags & cNMPCAN2_NMControlDebug)
  {
    write("[%.6f %NODE_NAME%]: Nm_PassiveStartUp()", TimeNowNS()/cNMCAN2_NS2S);
  }
  SetBusContext(gNMCAN2_BusContext);
  Nm_PassiveStartUp();
}

NMCAN2_PowerOnStart()
{
  //NMCAN2_PassiveBusStart();
}

on sysvar sysvar::NM_CAN2::StateControl::NmPduTxEnable
{
  SetBusContext(gNMCAN2_BusContext);
  if(@this == 1)
    Nm_DisablePassiveMode(); // NM PDU is transmitted after wake up, and in normal operation and repeat message state
  else 
    Nm_EnablePassiveMode(); // NM PDU is never transmitted
}

/*****************************************************************************
 * NM Indications
 * They are called from the NM simulation in order to control the IL.
 *****************************************************************************/

void NMCAN2_IndNetworkStart()
{
  if (gNMPCAN2_DebugFlags & cNMCAN2_NMIndDebug)
  {
    write("[%.6f %NODE_NAME%]: Nm_NetworkStartInd()", TimeNowNS()/cNMCAN2_NS2S);
  }
  NMCAN2_PassiveBusStart();
}

void NMCAN2_IndNetworkMode()
{
  if (gNMPCAN2_DebugFlags & cNMCAN2_NMIndDebug)
  {
    write("[%.6f %NODE_NAME%]: Nm_NetworkModeInd()", TimeNowNS()/cNMCAN2_NS2S);
  }
  StartSim(gNMCAN2_BusContext, 1, 4);
}

void NMCAN2_IndNetworkTimeout()
{
  if (gNMPCAN2_DebugFlags & cNMCAN2_NMIndDebug)
  {
    write("[%.6f %NODE_NAME%]: Nm_NetworkTimeoutInd()", TimeNowNS()/cNMCAN2_NS2S);
  }
}

void NMCAN2_IndPrepareBusSleepMode()
{
  if (gNMPCAN2_DebugFlags & cNMCAN2_NMIndDebug)
  {
    write("[%.6f %NODE_NAME%]: Nm_PrepareBusSleepModeInd()", TimeNowNS()/cNMCAN2_NS2S);
  }
  StopSim(gNMCAN2_BusContext, 1, 4);
}

void NMCAN2_IndBusSleepMode()
{
  if (gNMPCAN2_DebugFlags & cNMCAN2_NMIndDebug)
  {
    write("[%.6f %NODE_NAME%]: Nm_BusSleepModeInd()", TimeNowNS()/cNMCAN2_NS2S);
  }
}

void NMCAN2_IndStateChangeNotification( long previousState, long currentState) 
{
  long mode;
  if ((previousState == cCAN2_ASR_NM_STATE_UNDEFINED || previousState == cCAN2_ASR_NM_STATE_BUS_SLEEP) && (currentState != cCAN2_ASR_NM_STATE_BUS_SLEEP))
  { 
    @sysvar::NM_CAN2::StateControl::ActiveNodes += 1;
  }
  if ((previousState != cCAN2_ASR_NM_STATE_UNDEFINED) && (currentState == cCAN2_ASR_NM_STATE_BUS_SLEEP))
  { 
    @sysvar::NM_CAN2::StateControl::ActiveNodes -= 1;
  }

  gNMCAN2_CurrentNMState = currentState;

  if ((currentState <= cCAN2_ASR_NM_STATE_BUS_SLEEP) || (currentState > cCAN2_ASR_NM_STATE_SYNCHRONIZE))
  {
    mode = cCAN2_NM_NODE_MODE_Sleep_Mode;
  }
  else
  {
    if (currentState == cCAN2_ASR_NM_STATE_SYNCHRONIZE)
    {
      mode = cCAN2_NM_NODE_MODE_Synchronize_Mode;
    }
    else
    {
      mode = cCAN2_NM_NODE_MODE_Network_Mode;
    }
  }

  if (gNMPCAN2_DebugFlags & cNMCAN2_NMIndDebug)
  {
    write("[%.6f %NODE_NAME%]: NM currentState = %d, mode = %d", TimeNowNS()/cNMCAN2_NS2S, currentState, mode);
  }
}

/*****************************************************************************
 * EOF
 *****************************************************************************/
